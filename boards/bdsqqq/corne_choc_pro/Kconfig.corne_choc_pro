## boards/bdsqqq/corne_choc_pro/Kconfig.corne_choc_pro
```kconfig
# Copyright (c) 2020 The ZMK Contributors
# SPDX-License-Identifier: MIT

config BOARD_CORNE_CHOC_PRO
	select SOC_NRF52840_QIAA
```

## boards/bdsqqq/corne_choc_pro/Kconfig.corne_choc_pro_left
```kconfig
# Copyright (c) 2020 The ZMK Contributors
# SPDX-License-Identifier: MIT

config BOARD_CORNE_CHOC_PRO_LEFT
	select SOC_NRF52840_QIAA
```

## boards/bdsqqq/corne_choc_pro/Kconfig.defconfig
```kconfig
# Copyright (c) 2020 The ZMK Contributors
# SPDX-License-Identifier: MIT

if BOARD_CORNE_CHOC_PRO

config ZMK_SPLIT
    default y

if USB

config USB_NRFX
	default y

config USB_DEVICE_STACK
	default y

endif # USB

config BT_CTLR
	default BT

config ZMK_BLE_EXPERIMENTAL_CONN
	default y

config I2C
	default y

config ZMK_MAX17048
    default y

endif # BOARD_CORNE_CHOC_PRO
```

## boards/bdsqqq/corne_choc_pro/board.yml
```yaml
board:
  - name: corne_choc_pro_left
    vendor: bdsqqq
    socs:
      - name: nrf52840
  - name: corne_choc_pro_right
    vendor: bdsqqq
    socs:
      - name: nrf52840
```

## boards/bdsqqq/corne_choc_pro/corne_choc_pro_left_defconfig
```kconfig
# SPDX-License-Identifier: MIT

# Enable deep sleep
CONFIG_ZMK_SLEEP=y

# Enable MPU
CONFIG_ARM_MPU=y

# Enable GPIO
CONFIG_GPIO=y

CONFIG_USE_DT_CODE_PARTITION=y
CONFIG_BUILD_OUTPUT_UF2=y

CONFIG_MPU_ALLOW_FLASH_WRITE=y
CONFIG_NVS=y
CONFIG_SETTINGS_NVS=y
CONFIG_FLASH=y
CONFIG_FLASH_PAGE_LAYOUT=y
CONFIG_FLASH_MAP=y

CONFIG_ZMK_USB=y
CONFIG_ZMK_BLE=y
CONFIG_BT_CTLR_TX_PWR_PLUS_8=y

# Enable I2C
CONFIG_I2C=y
CONFIG_I2C_NRFX=y
CONFIG_PINCTRL=y

# Enable encoder
CONFIG_EC11=y
CONFIG_EC11_TRIGGER_GLOBAL_THREAD=y

# Enable RGB underglow
CONFIG_ZMK_RGB_UNDERGLOW=y
CONFIG_ZMK_RGB_UNDERGLOW_BRT_MAX=20
CONFIG_ZMK_RGB_UNDERGLOW_HUE_START=48
CONFIG_ZMK_RGB_UNDERGLOW_SAT_START=96

# Windows Battery Reporting Fix
CONFIG_BT_GATT_ENFORCE_SUBSCRIPTION=n

# Enable ZMK Studio (alpha)
CONFIG_ZMK_STUDIO=y

# Split keyboard central
CONFIG_ZMK_KEYBOARD_NAME="Corne Choc Pro"
CONFIG_ZMK_SPLIT_ROLE_CENTRAL=y
```
